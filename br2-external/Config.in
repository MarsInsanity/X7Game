## br2-external/Config.in
```kconfig
source "$BR2_EXTERNAL_X7GAME_PATH/package/x7-hwmon/Config.in"
source "$BR2_EXTERNAL_X7GAME_PATH/package/libudev-zero/Config.in"
source "$BR2_EXTERNAL_X7GAME_PATH/package/retroarch/Config.in"
source "$BR2_EXTERNAL_X7GAME_PATH/package/pcsx4all/Config.in"

menu "libretro cores"
source "$BR2_EXTERNAL_X7GAME_PATH/package/libretro-cores.in"
endmenu
```

## br2-external/package/libretro-beetle-pce-fast/Config.in
```kconfig
config BR2_PACKAGE_LIBRETRO_BEETLE_PCE_FAST
	bool "libretro-beetle-pce-fast"
	depends on BR2_PACKAGE_RETROARCH
	depends on BR2_INSTALL_LIBSTDCPP
	help
	  Beetle PCE Fast (Mednafen) libretro core: PC Engine /
	  TurboGrafx-16 and PC Engine CD.

	  https://github.com/libretro/beetle-pce-fast-libretro
```

## br2-external/package/libretro-beetle-wswan/Config.in
```kconfig
config BR2_PACKAGE_LIBRETRO_BEETLE_WSWAN
	bool "libretro-beetle-wswan"
	depends on BR2_PACKAGE_RETROARCH
	help
	  Beetle WonderSwan (Mednafen) libretro core: WonderSwan and
	  WonderSwan Color.

	  https://github.com/libretro/beetle-wswan-libretro
```

## br2-external/package/libretro-fbalpha2012-cps1/Config.in
```kconfig
config BR2_PACKAGE_LIBRETRO_FBALPHA2012_CPS1
	bool "libretro-fbalpha2012-cps1"
	depends on BR2_PACKAGE_RETROARCH
	depends on BR2_INSTALL_LIBSTDCPP
	help
	  FB Alpha 2012 CPS-1 libretro core: Capcom CP System arcade
	  games.

	  https://github.com/libretro/fbalpha2012_cps1
```

## br2-external/package/libretro-fbalpha2012-cps2/Config.in
```kconfig
config BR2_PACKAGE_LIBRETRO_FBALPHA2012_CPS2
	bool "libretro-fbalpha2012-cps2"
	depends on BR2_PACKAGE_RETROARCH
	depends on BR2_INSTALL_LIBSTDCPP
	help
	  FB Alpha 2012 CPS-2 libretro core: Capcom CP System II arcade
	  games.

	  https://github.com/libretro/fbalpha2012_cps2
```

## br2-external/package/libretro-fbalpha2012-neogeo/Config.in
```kconfig
config BR2_PACKAGE_LIBRETRO_FBALPHA2012_NEOGEO
	bool "libretro-fbalpha2012-neogeo"
	depends on BR2_PACKAGE_RETROARCH
	depends on BR2_INSTALL_LIBSTDCPP
	help
	  FB Alpha 2012 Neo Geo libretro core: SNK Neo Geo MVS / AES
	  arcade games.

	  https://github.com/libretro/fbalpha2012_neogeo
```

## br2-external/package/libretro-fceumm/Config.in
```kconfig
config BR2_PACKAGE_LIBRETRO_FCEUMM
	bool "libretro-fceumm"
	depends on BR2_PACKAGE_RETROARCH
	help
	  FCEUmm libretro core: Nintendo Entertainment System, Famicom
	  and Famicom Disk System.

	  https://github.com/libretro/libretro-fceumm
```

## br2-external/package/libretro-gambatte/Config.in
```kconfig
config BR2_PACKAGE_LIBRETRO_GAMBATTE
	bool "libretro-gambatte"
	depends on BR2_PACKAGE_RETROARCH
	depends on BR2_INSTALL_LIBSTDCPP
	help
	  Gambatte libretro core: Game Boy and Game Boy Color.

	  https://github.com/libretro/gambatte-libretro
```

## br2-external/package/libretro-gpsp/Config.in
```kconfig
config BR2_PACKAGE_LIBRETRO_GPSP
	bool "libretro-gpsp"
	depends on BR2_PACKAGE_RETROARCH
	depends on BR2_INSTALL_LIBSTDCPP
	help
	  gpSP libretro core: Game Boy Advance, with its MIPS dynamic
	  recompiler.

	  https://github.com/libretro/gpsp
```

## br2-external/package/libretro-handy/Config.in
```kconfig
config BR2_PACKAGE_LIBRETRO_HANDY
	bool "libretro-handy"
	depends on BR2_PACKAGE_RETROARCH
	depends on BR2_INSTALL_LIBSTDCPP
	help
	  Handy libretro core: Atari Lynx.

	  https://github.com/libretro/libretro-handy
```

## br2-external/package/libretro-picodrive/Config.in
```kconfig
config BR2_PACKAGE_LIBRETRO_PICODRIVE
	bool "libretro-picodrive"
	depends on BR2_PACKAGE_RETROARCH
	help
	  PicoDrive libretro core: Sega Mega Drive / Genesis, Mega-CD,
	  32X (MIPS SH2 recompiler), Master System, Game Gear and Pico.

	  https://github.com/libretro/picodrive
```

## br2-external/package/libretro-prosystem/Config.in
```kconfig
config BR2_PACKAGE_LIBRETRO_PROSYSTEM
	bool "libretro-prosystem"
	depends on BR2_PACKAGE_RETROARCH
	help
	  ProSystem libretro core: Atari 7800.

	  https://github.com/libretro/prosystem-libretro
```

## br2-external/package/libretro-race/Config.in
```kconfig
config BR2_PACKAGE_LIBRETRO_RACE
	bool "libretro-race"
	depends on BR2_PACKAGE_RETROARCH
	help
	  RACE libretro core: Neo Geo Pocket and Neo Geo Pocket Color.

	  https://github.com/libretro/RACE
```

## br2-external/package/libretro-snes9x2005/Config.in
```kconfig
config BR2_PACKAGE_LIBRETRO_SNES9X2005
	bool "libretro-snes9x2005"
	depends on BR2_PACKAGE_RETROARCH
	help
	  Snes9x 2005 libretro core: Super Nintendo / Super Famicom,
	  the fast, older Snes9x 1.43 for slow CPUs.

	  https://github.com/libretro/snes9x2005
```

## br2-external/package/libretro-stella2014/Config.in
```kconfig
config BR2_PACKAGE_LIBRETRO_STELLA2014
	bool "libretro-stella2014"
	depends on BR2_PACKAGE_RETROARCH
	depends on BR2_INSTALL_LIBSTDCPP
	help
	  Stella 2014 libretro core: Atari 2600 (the older, lighter
	  Stella 3.9).

	  https://github.com/libretro/stella2014-libretro
```

## br2-external/package/libudev-zero/Config.in
```kconfig
config BR2_PACKAGE_LIBUDEV_ZERO
	bool "libudev-zero"
	depends on !BR2_PACKAGE_HAS_UDEV
	help
	  A libudev replacement that works without a udev daemon (it
	  reads sysfs). RetroArch's udev input drivers use it to find
	  the "X7 Game Gamepad" virtual pad.

	  https://github.com/illiliti/libudev-zero
```

## br2-external/package/pcsx4all/Config.in
```kconfig
config BR2_PACKAGE_PCSX4ALL
	bool "pcsx4all"
	depends on BR2_mipsel # MIPS dynarec, Makefile.r36sx
	depends on BR2_INSTALL_LIBSTDCPP # gpu_unai is C++
	depends on BR2_TOOLCHAIN_HAS_THREADS # alsa-lib
	depends on BR2_USE_MMU
	select BR2_PACKAGE_ALSA_LIB
	select BR2_PACKAGE_ALSA_LIB_PCM
	select BR2_PACKAGE_ZLIB
	help
	  PCSX4ALL, a standalone PlayStation emulator for slow
	  handhelds: gameblabla's RG350 fork (MIPS dynarec, gpu_unai
	  with gpulib, spu_pcsxrearmed, CHD through libchdr) with the
	  X7 Game port (Makefile.r36sx, src/port/r36sx): the picture
	  scaled to the 640x480 framebuffer, the "X7 Game Gamepad",
	  ALSA sound. No SDL.

	    pcsx4all -iso <.cue/.bin/.img/.iso/.chd/.pbp>

	  BIOS from /share/bios (scph1001.bin, scph5501.bin, ...; the
	  HLE BIOS when there is none), memory cards and save states
	  in /share/saves/psx, settings in /share/system/pcsx4all.

	  https://github.com/gameblabla/pcsx4all_rs97_rg350
```

## br2-external/package/retroarch/Config.in
```kconfig
config BR2_PACKAGE_RETROARCH
	bool "retroarch"
	depends on BR2_INSTALL_LIBSTDCPP
	depends on BR2_TOOLCHAIN_HAS_THREADS
	depends on BR2_USE_MMU
	select BR2_PACKAGE_ALSA_LIB
	select BR2_PACKAGE_ALSA_LIB_PCM
	select BR2_PACKAGE_ALSA_LIB_MIXER
	select BR2_PACKAGE_ALSA_LIB_SEQ # midi/drivers/alsa_midi.c
	select BR2_PACKAGE_LIBUDEV_ZERO
	help
	  RetroArch, the libretro frontend, in a slim build for the
	  R36SX (Makefile.r36sx): RGUI menu, the x7fb framebuffer video
	  driver (RGB565 on /dev/fb0), udev input, ALSA audio; no
	  networking, OpenGL, shaders or overlays.

	  https://www.retroarch.com
```

## br2-external/package/x7-hwmon/Config.in
```kconfig
config BR2_PACKAGE_X7_HWMON
	bool "x7-hwmon"
	depends on BR2_USE_MMU # fork, alsa-utils
	depends on BR2_TOOLCHAIN_HAS_THREADS # alsa-utils
	select BR2_PACKAGE_ALSA_UTILS # amixer: volume keys
	select BR2_PACKAGE_ALSA_UTILS_AMIXER
	help
	  X7 Game's system daemons and tools:

	  x7-hwmon: the hardware monitor daemon (started by init). It
	  turns the console off with the power button or when the
	  battery runs low, handles the volume keys, and reports the
	  battery, charger, headphone jack and OTG port in the event
	  log /run/x7-events.log. "x7-hwmon --status" prints the
	  hardware state (x7-status, x7-console and the game list's
	  System information page use it).

	  x7-padd: the virtual gamepad "X7 Game Gamepad" that the
	  emulators read (started by init).

	  x7-browser: the temporary text-mode game list on the screen
	  (started by init).

	  x7-datapart: writes the data partition's (X7DATA) entry in
	  the SD card's partition table at the first start
	  (S05x7data), and reports whether X7DATA was closed cleanly.

	  x7-fbspeed: measures how fast programs can write the screen,
	  uncached and write-combined.

comment "x7-hwmon needs a toolchain w/ threads"
	depends on BR2_USE_MMU
	depends on !BR2_TOOLCHAIN_HAS_THREADS
```
